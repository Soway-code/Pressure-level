## Cap_liquid_level_sensor/board/Kconfig
```kconfig
menu "Hardware Drivers Config"

config SOC_STM32F072xB
    bool
    select SOC_SERIES_STM32F0
    default y

menu "Onboard Peripheral Drivers"

    config BSP_USING_USB_TO_USART
        bool "Enable USB TO USART (uart2)"
        select BSP_USING_UART
        select BSP_USING_UART2
        default y

endmenu

menu "On-chip Peripheral Drivers"

    config BSP_USING_GPIO
        bool "Enable GPIO"
        select RT_USING_PIN
        default y

    menuconfig BSP_USING_UART
        bool "Enable UART"
        default y
		select RT_USING_SERIAL
        if BSP_USING_UART
            config BSP_USING_UART1
                bool "Enable UART1"
                default y

            config BSP_UART1_RX_USING_DMA
                bool "Enable UART1 RX DMA"
                depends on BSP_USING_UART1 && RT_SERIAL_USING_DMA
                default n

            config BSP_USING_UART2
                bool "Enable UART2"
                default n

            config BSP_UART2_RX_USING_DMA
                bool "Enable UART2 RX DMA"
                depends on BSP_USING_UART2 && RT_SERIAL_USING_DMA
                default n

        endif

    menuconfig BSP_USING_SPI
        bool "Enable SPI BUS"
        default n
        select RT_USING_SPI
        if BSP_USING_SPI
            config BSP_USING_SPI1
                bool "Enable SPI1 BUS"
                default n

            config BSP_SPI1_TX_USING_DMA
                bool "Enable SPI1 TX DMA"
                depends on BSP_USING_SPI1
                default n
                
            config BSP_SPI1_RX_USING_DMA
                bool "Enable SPI1 RX DMA"
                depends on BSP_USING_SPI1
                select BSP_SPI1_TX_USING_DMA
                default n
        endif

        
    menuconfig BSP_USING_I2C1
        bool "Enable I2C1 BUS (software simulation)"
        default n
        select RT_USING_I2C
        select RT_USING_I2C_BITOPS
        select RT_USING_PIN
        if BSP_USING_I2C1
            config BSP_I2C1_SCL_PIN
                int "i2c1 scl pin number"
                range 1 216
                default 34
            config BSP_I2C1_SDA_PIN
                int "I2C1 sda pin number"
                range 1 216
                default 35
        endif

    menuconfig BSP_USING_TIM
        bool "Enable timer"
        default n
        select RT_USING_HWTIMER
        if BSP_USING_TIM
            config BSP_USING_TIM2
                bool "Enable TIM2"
                default n

            config BSP_USING_TIM3
                bool "Enable TIM3"
                default n

        endif

    menuconfig BSP_USING_PWM
        bool "Enable pwm"
        default n
        select RT_USING_PWM
        if BSP_USING_PWM
        menuconfig BSP_USING_PWM2
            bool "Enable timer2 output pwm"
            default n
            if BSP_USING_PWM2
                config BSP_USING_PWM2_CH4
                    bool "Enable PWM2 channel4"
                    default n
            endif
        endif

    menuconfig BSP_USING_ADC
        bool "Enable ADC"
        default n
        select RT_USING_ADC
        if BSP_USING_ADC
            config BSP_USING_ADC1
                bool "Enable ADC1"
                default n

			config BSP_ADC_USING_DMA
				bool

			config BSP_ADC1_USING_DMA
                bool "Enable ADC1 DMA"
                depends on BSP_USING_ADC1				
                default n
				select BSP_ADC_USING_DMA
				select RT_ADC_USING_DMA
        endif

    config BSP_USING_ON_CHIP_FLASH
        bool "Enable on-chip FLASH"
        default n 

    menuconfig BSP_USING_ONCHIP_RTC
        bool "Enable RTC"
        select RT_USING_RTC
        select RT_USING_LIBC
        default n
        if BSP_USING_ONCHIP_RTC
            choice
                prompt "Select clock source"
                default BSP_RTC_USING_LSE

                config BSP_RTC_USING_LSE
                    bool "RTC USING LSE"

                config BSP_RTC_USING_LSI
                    bool "RTC USING LSI"
            endchoice
        endif

    config BSP_USING_WDT
        bool "Enable Watchdog Timer"
        select RT_USING_WDT
        default n

endmenu

menu "Board extended module Drivers"

	config BSP_USING_PIN
		bool

	config APP_USING_ADC_APP
		bool
	config BSP_USING_ADC_BSP
        bool "Using ADC_BSP Driver"
		select APP_USING_ADC_APP
		select BSP_USING_PIN
        default n

	config BSP_USING_DAC_BSP
        bool "Using DAC_BSP Driver"
		select BSP_USING_PIN
        default n

	config APP_USING_IN_FLASH_APP
		bool
	config BSP_USING_IN_FLASH
        bool "Using In_Flash Driver"
		select APP_USING_IN_FLASH_APP
        default n

	config APP_USING_PICOCAP_APP
		bool
	config BSP_SPI_BSP
		bool
	config BSP_USING_PICOCAP
        bool "Using Picocap Driver"
		select APP_USING_PICOCAP_APP
		select BSP_SPI_BSP
		select BSP_USING_PIN
        default n

	config APP_USING_USART_APP
		bool
	config BSP_USING_USART_BSP
        bool "Using USART_BSP Driver"
		select APP_USING_USART_APP
		select BSP_USING_PIN
        default n

	config APP_USING_MODBUS
		bool "Using ModBus(Default RTU)"
        default n

endmenu

endmenu
```
