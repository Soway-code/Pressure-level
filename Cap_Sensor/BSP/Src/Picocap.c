/****************************************************************************************************************************************************************
** 版权:          2020-2030,深圳市信为科技发展有限公司
** 文件名:        Picocap.c
** 作者:          杨春林
** 版本:          V1.0.0
** 日期:          2020-04-30
** 描述:          PCap芯片配置与应用
** 功能:          PCap驱动 电容数据 温度数据采集
*****************************************************************************************************************************************************************
** 修改者:        No
** 版本:          No
** 修改内容:      No
** 日期:          No
****************************************************************************************************************************************************************/

#include "Picocap.h"
#include "SoftSpi.h"

//PCap固件
const unsigned char SRAM_DATA[] = {
0x00,0x00,0x00,0x62,0x63,0x00,0x65,0xBE,0x01,0x20,0x26,0x42,0x5C,0x48,0xA0,0x03,
0x21,0xE4,0x20,0x31,0xA1,0x03,0x21,0xE4,0x20,0x31,0x84,0x01,0x23,0x63,0x01,0x00,
0x00,0x00,0x00,0x00,0x20,0x0B,0x43,0x58,0xC0,0xFE,0x43,0xC0,0x44,0x7A,0x7E,0x20,
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0xF2,0x02,0xFF,0xFF,0xFF,0xFF,0xFF,0xFF,0xFF,0xFF,0xFF,0xFF,0xFF,0xFF,0xFF,0xFF,
};

//配置寄存器
//详见Picocap.h的21个配置寄存器的配置
const unsigned long REG[] = {
    REG0_OTP_CONFIG_VALUE,              //addr0
    REG1_IN_OSC_CONFIG_VALUE,           //addr1
    REG2_CAP_MEASURE_VALUE,             //addr2
    REG3_CAP_MEASURE_VALUE,             //addr3
    REG4_CAP_TEMP_MEASURE_VALUE,        //addr4
    REG5_TEMP_MEASURE_VALUE,            //addr5
    REG6_TEMP_MEASURE_VALUE,            //addr6            
    REG7_CONFIG_VALUE,                  //addr7
    REG8_DSP_CONFIG_VALUE,              //addr8
    REG9_GPIO_CONFIG_VALUE,             //addr9
    REG10_IN_1_8V_REGULATOR_VALUE,      //addr10
    PARAM0_VALUE,                       //addr11
    PARAM1_VALUE,                       //addr12
    PARAM2_PULSE_SELECT_VALUE,          //addr13
    PARAM3_PULSE0_SLOPE_VALUE,          //addr14
    PARAM4_PULSE0_OFFSET_VALUE,         //addr15
    PARAM5_PULSE1_SLOPE_VALUE,          //addr16
    PARAM6_PULSE1_OFFSET_VALUE,         //addr17
    PARAM7_CAP_MEASURE_CONFIG_VALUE,    //addr18
    PARAM8_GAIN_CORR_VALUE,             //addr19
    REG20_RUNBIT_VALUE,                 //addr20
};

/**
* 名称       : PCap_Init()
* 创建日期   : 2020-04-30
* 作者       : 杨春林
* 功能       : PCap芯片初始化
* 输入参数   : 无
* 输出参数   : 无
* 返回结果   : 无
* 注意和说明 : 
* 修改内容   :
*/
void PCap_Init(void)
{
    //写PCap SRAM错误
    uint8_t WrSramErr;
    //写PCap 次数
    uint8_t WrSramCnt;

    WrSramErr = 0;
    WrSramCnt = 0;

    //SPI初始化
    SPI_Init();
    //PCap复位
    PCap_Reset();
    //延时1ms
    Delay_us(1000);
    //写PCap固件
    do
    {
        WrSramErr = PCap_WR_SRAM();
        if(OP_SUCCESS == WrSramErr)
        {
            break;
        }

        PCap_Reset();
        WrSramCnt++;
        Delay_us(100);
    }while(WRITE_PCAPFIRM_ERR_MAX > WrSramCnt);

    Delay_us(100);
    //PCap寄存器配置
    PCap_Reg_Config();
    //PCap使能
    PCap_Enable();
    Delay_us(100);
    //PCap部分复位
    PCap_PTL_Reset();
    Delay_us(200);
    //PCap测量开始
    PCap_Measure();
}

/**
* 名称       : PCap_Reset()
* 创建日期   : 2020-04-30
* 作者       : 杨春林
* 功能       : PCap芯片复位
* 输入参数   : 无
* 输出参数   : 无
* 返回结果   : 无
* 注意和说明 : 
* 修改内容   :
*/
void PCap_Reset(void)
{
    SPI_ENABLE;
    Delay_us(1);
    SPI_Send_8Bit(PCAP_RESET_CMD);
    SPI_DISABLE;
    Delay_us(1);
}

/**
* 名称       : PCap_PTL_Reset()
* 创建日期   : 2020-04-30
* 作者       : 杨春林
* 功能       : PCap芯片部分复位
* 输入参数   : 无
* 输出参数   : 无
* 返回结果   : 无
* 注意和说明 : 
* 修改内容   :
*/
void PCap_PTL_Reset(void)
{
    SPI_ENABLE;
    Delay_us(1);
    SPI_Send_8Bit(PCAP_PTL_RESET_CMD);
    SPI_DISABLE;
    Delay_us(1);
}

/**
* 名称       : PCap_Measure()
* 创建日期   : 2020-04-30
* 作者       : 杨春林
* 功能       : PCap芯片开始测量
* 输入参数   : 无
* 输出参数   : 无
* 返回结果   : 无
* 注意和说明 : 
* 修改内容   :
*/
void PCap_Measure(void)
{
  SPI_ENABLE;
  Delay_us(1);
  SPI_Send_8Bit(PCAP_MEASURE_CMD);
  SPI_DISABLE;
  Delay_us(1); 
}

/**
* 名称       : PCap_Enable()
* 创建日期   : 2020-04-30
* 作者       : 杨春林
* 功能       : PCap芯片启动
* 输入参数   : 无
* 输出参数   : 无
* 返回结果   : 无
* 注意和说明 : 
* 修改内容   :
*/
void PCap_Enable(void)
{
    SPI_ENABLE;
    Delay_us(1);
    SPI_Send_32Bit(((uint32_t )(PCAP_WRITE_CONFIG_OPT | CONFIG_REG20_ADDR) << 24) | REG20_RUN_ENABLE);
    SPI_DISABLE;
    Delay_us(1); 
}

/**
* 名称       : PCap_Disable()
* 创建日期   : 2020-04-30
* 作者       : 杨春林
* 功能       : PCap芯片停止
* 输入参数   : 无
* 输出参数   : 无
* 返回结果   : 无
* 注意和说明 : 
* 修改内容   :
*/
void PCap_Disable(void)
{
  SPI_ENABLE;
  Delay_us(1);
  SPI_Send_32Bit(((uint32_t )(PCAP_WRITE_CONFIG_OPT | CONFIG_REG20_ADDR) << 24) | REG20_RUN_DISABLE);
  SPI_DISABLE;
  Delay_us(1);
}

/**
* 名称       : PCap_WR_SRAM()
* 创建日期   : 2020-04-30
* 作者       : 杨春林
* 功能       : 向PCap芯片写入固件
* 输入参数   : 无
* 输出参数   : 无
* 返回结果   : OP_SUCCESS(写入成功),OP_FAILED(写入失败)
* 注意和说明 : 
* 修改内容   :
*/
uint8_t PCap_WR_SRAM(void)
{
  uint8_t rddata;
  uint8_t errcnt;
  uint8_t *pWrdata;
  uint16_t pCnt;
  
  rddata = 0;
  errcnt = 0;
  pWrdata = (uint8_t *)SRAM_DATA;
  
  for(pCnt = 0; pCnt < SRAM_DATA_NUM; pCnt++)
  {
    do
    {
      SPI_ENABLE;
      Delay_us(1);
      SPI_Send_16Bit((PCAP_WRITE_SRAM_OPT << 8) | pCnt);
      SPI_Send_8Bit(*pWrdata);
      SPI_DISABLE;
    
      Delay_us(30);
    
      SPI_ENABLE;
      Delay_us(1);
      SPI_Send_16Bit((PCAP_READ_SRAM_OPT << 8) | pCnt);
      rddata = SPI_Receive_8Bit();
      SPI_DISABLE;
      Delay_us(1); 
    
      errcnt++;
      
      if(WRITE_PCAPFIRM_ERR_MAX < errcnt)
      {
        return OP_FAILED;
      }
      
    }while(*pWrdata != rddata);
    
    errcnt = 0;
    pWrdata++;
  }
  
  return OP_SUCCESS;
}

/**
* 名称       : PCap_Reg_Config()
* 创建日期   : 2020-04-30
* 作者       : 杨春林
* 功能       : 向PCap芯片写入配置信息
* 输入参数   : 无
* 输出参数   : 无
* 返回结果   : 无
* 注意和说明 : 
* 修改内容   :
*/
void PCap_Reg_Config(void)
{
  uint8_t rCnt;
  
  for(rCnt = 0; rCnt < REG_CONF_NUM; rCnt++)
  {
    SPI_ENABLE;
    Delay_us(1);
    SPI_Send_32Bit(((uint32_t )(PCAP_WRITE_CONFIG_OPT | rCnt) << 24) | REG[rCnt]);
    SPI_DISABLE;
    Delay_us(1);
  }
}

/**
* 名称       : PCap_Res_Sta()
* 创建日期   : 2020-04-30
* 作者       : 杨春林
* 功能       : 读取PCap芯片状态
* 输入参数   : 无
* 输出参数   : 无
* 返回结果   : PCap状态
* 注意和说明 : 
* 修改内容   :
*/
uint32_t PCap_Res_Sta(void)
{
  uint32_t p_sta;
  
  p_sta = 0;
  SPI_ENABLE;
  Delay_us(1);
  SPI_Send_8Bit(PCAP_READ_RESULT_OPT | RESULT_STATUS_ADDR);
  p_sta = SPI_Receive_24Bit();
  SPI_DISABLE;
  Delay_us(1);
  return p_sta;
}

/**
* 名称       : PCap_Res_Capacitance()
* 创建日期   : 2020-04-30
* 作者       : 杨春林
* 功能       : 读取PCap芯片电容数据
* 输入参数   : 无
* 输出参数   : 无
* 返回结果   : PCap电容数据
* 注意和说明 : 
* 修改内容   :
*/
uint32_t PCap_Res_Capacitance(uint8_t reg_addr)
{
  uint32_t p_res;
  
  p_res = 0;
  SPI_ENABLE;
  Delay_us(1);
  SPI_Send_8Bit(PCAP_READ_RESULT_OPT | reg_addr);
  p_res = SPI_Receive_24Bit();
  SPI_DISABLE;
  Delay_us(1);
  return p_res;
}

/**
* 名称       : PCap_Res_Temperature()
* 创建日期   : 2020-04-30
* 作者       : 杨春林
* 功能       : 读取PCap芯片温度数据
* 输入参数   : 无
* 输出参数   : 无
* 返回结果   : PCap温度数据
* 注意和说明 : 
* 修改内容   :
*/
uint32_t PCap_Res_Temperature(void)
{
  uint32_t p_temp;
  
  p_temp = 0;
  SPI_ENABLE;
  Delay_us(1);
  SPI_Send_8Bit(PCAP_READ_RESULT_OPT | RESULT_REG10_ADDR);
  p_temp = SPI_Receive_24Bit();
  SPI_DISABLE;
  Delay_us(1);
  return p_temp;
}
